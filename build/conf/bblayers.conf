## build/conf/bblayers.conf
```bitbake
# POKY_BBLAYERS_CONF_VERSION is increased each time build/conf/bblayers.conf
# changes incompatibly
POKY_BBLAYERS_CONF_VERSION = "2"

BBPATH = "${TOPDIR}"
BBFILES ?= ""

BBLAYERS ?= " \
  /home/ats/projects/yocto/rockchip_v2/layers/poky/meta \
  /home/ats/projects/yocto/rockchip_v2/layers/poky/meta-poky \
  /home/ats/projects/yocto/rockchip_v2/layers/poky/meta-yocto-bsp \
  /home/ats/projects/yocto/rockchip_v2/layers/meta-openembedded/meta-oe \
  /home/ats/projects/yocto/rockchip_v2/layers/meta-rockchip \
  "
```

## layers/meta-rockchip/conf/machine/aio-3288c.conf
```bitbake
# Copyright (c) 2020, Fuzhou Rockchip Electronics Co., Ltd
# Released under the MIT license (see COPYING.MIT for the terms)

#@TYPE: Machine
#@RK_PRODUCT_MODEL: AIO_3288C

require conf/machine/firefly-rk3288.conf

KERNEL_DEVICETREE = "rockchip/rk3288-firefly-aioc.dtb"
```

## layers/meta-rockchip/conf/machine/aio-3588q.conf
```bitbake
#@TYPE: Machine
#@RK_PRODUCT_MODEL: ROC_RK3588_PC

require conf/machine/firefly-rk3588.conf

KERNEL_DEVICETREE = "rockchip/rk3588-firefly-aio-3588q-mipi101-M101014-BE45-A1.dtb"
CPU_SERIES = "RK3588"
```

## layers/meta-rockchip/conf/machine/firefly-rk3288.conf
```bitbake
# Copyright (c) 2019, Fuzhou Rockchip Electronics Co., Ltd
# Released under the MIT license (see COPYING.MIT for the terms)

#@TYPE: Machine
#@RK_PRODUCT_MODEL: FIREFLY_RK3288

require conf/machine/include/rk3288.inc
require conf/machine/include/firefly.inc

FIREFLY_SDK_BRANCH = "rk3288/firefly"
FIREFLY_SDK_VERSION = "rk3288/linux_release_v2.5.0a"

KBUILD_DEFCONFIG = "firefly_linux_defconfig"
KERNEL_DEVICETREE = "rk3288-firefly.dtb"

UBOOT_MACHINE = "firefly-rk3288_defconfig"
RK_TEE_ADDR = "0x08400000"
```

## layers/meta-rockchip/conf/machine/firefly-rk3328.conf
```bitbake
# Copyright (c) 2020, Fuzhou Rockchip Electronics Co., Ltd
# Released under the MIT license (see COPYING.MIT for the terms)

#@TYPE: Machine
#@RK_PRODUCT_MODEL: FIREFLY_3328

require conf/machine/include/rk3328.inc
require conf/machine/include/firefly.inc

FIREFLY_SDK_BRANCH = "rk3399/firefly"
FIREFLY_SDK_VERSION = "rk3399/linux_release_v2.5.1a"

KBUILD_DEFCONFIG = "firefly-rk3328_defconfig"
KERNEL_DEVICETREE = "rockchip/rk3328-roc-cc.dtb"

UBOOT_MACHINE = "firefly-rk3328_defconfig"
```

## layers/meta-rockchip/conf/machine/firefly-rk3399.conf
```bitbake
# Copyright (c) 2019, Fuzhou Rockchip Electronics Co., Ltd
# Released under the MIT license (see COPYING.MIT for the terms)

#@TYPE: Machine
#@RK_PRODUCT_MODEL: FIREFLY_3399

require conf/machine/include/rk3399.inc
require conf/machine/include/firefly.inc

FIREFLY_SDK_BRANCH = "rk3399/firefly"
FIREFLY_SDK_VERSION = "rk3399/linux_release_v2.5.1a"

KBUILD_DEFCONFIG = "firefly_linux_defconfig"
KERNEL_DEVICETREE = "rockchip/rk3399-firefly-linux.dtb"

UBOOT_MACHINE = "firefly-rk3399_defconfig"

MACHINE_EXTRA_RRECOMMENDS:append += " \
	linux-firmware-rk-cdndp \
"
```

## layers/meta-rockchip/conf/machine/firefly-rk3566.conf
```bitbake
# Copyright (c) 2020, Rockchip Electronics Co., Ltd
# Released under the MIT license (see COPYING.MIT for the terms)

#@TYPE: Machine
#@RK_PRODUCT_MODEL: ROC_RK3566_PC

require conf/machine/include/rk356x.inc
require conf/machine/include/firefly.inc

FIREFLY_SDK_BRANCH = "rk356x/firefly"
FIREFLY_SDK_VERSION = "rk356x/linux_release_v1.3.0a"

KBUILD_DEFCONFIG = "firefly_linux_defconfig"
KERNEL_DEVICETREE = "rockchip/rk3566-firefly-roc-pc.dtb"

UBOOT_MACHINE = "firefly-rk3566_defconfig"


MACHINE_EXTRA_RRECOMMENDS:append = " \
	drm-cursor \
"
```

## layers/meta-rockchip/conf/machine/firefly-rk3588.conf
```bitbake
# Copyright (c) 2020, Rockchip Electronics Co., Ltd
# Released under the MIT license (see COPYING.MIT for the terms)

#@TYPE: Machine
#@RK_PRODUCT_MODEL: ROC_RK3588_PC

require conf/machine/include/rk3588.inc
require conf/machine/include/firefly.inc

FIREFLY_SDK_BRANCH = "rk3588/firefly"
FIREFLY_SDK_VERSION = "rk3588/linux_release_v1.0.6e"

KBUILD_DEFCONFIG = "rockchip_linux_defconfig"
KERNEL_DEVICETREE = "rockchip/roc-rk3588-pc.dtb"

UBOOT_MACHINE = "rk3588_defconfig firefly-linux.config"

MACHINE_EXTRA_RRECOMMENDS:append = " \
	drm-cursor \
"

PACKAGE_CLASSES = "package_deb"
EXTRA_IMAGE_FEATURES += "package-management"
```

## layers/meta-rockchip/conf/machine/include/rk3328.inc
```bitbake
# Copyright (c) 2020, Fuzhou Rockchip Electronics Co., Ltd
# Released under the MIT license (see COPYING.MIT for the terms)

MACHINEOVERRIDES =. "rk3328:"
SOC_FAMILY ?= "rk3328"
require conf/machine/include/rockchip-arm64-common.inc

MALI_GPU := "utgard-450"
MALI_VERSION ?= "r7p0"
```

## layers/meta-rockchip/conf/machine/roc-rk3588s-pc-ext.conf
```bitbake
#@TYPE: Machine
#@RK_PRODUCT_MODEL: ROC_RK3588_PC

require conf/machine/firefly-rk3588.conf

KERNEL_DEVICETREE = "rockchip/roc-rk3588s-pc-ext.dtb"
CPU_SERIES = "RK3588"
```
